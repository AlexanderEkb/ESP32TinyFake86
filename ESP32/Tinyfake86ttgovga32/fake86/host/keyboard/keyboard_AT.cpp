#include "keyboard_AT.h"
#include "../config/config.h"
#include "../../machines/ibm_xt/chipset/i8259.h"
#include "keys.h"
#include <Arduino.h>
#include <esp32-hal-gpio.h>
#include "freertos/FreeRTOS.h"
#include "freertos/queue.h"
#include <esp_log.h>

#define TAG "KEYB"

#if (KEYBOARD_DRIVER == 1)

QueueHandle_t KeyboardDriverAT::q;

KeyboardDriverAT::KeyboardDriverAT() {
  q = xQueueCreate(16, 1);
}

void KeyboardDriverAT::Init()
{
  pinMode(KEYBOARD_DATA, INPUT_PULLUP);
  pinMode(KEYBOARD_CLK, INPUT_PULLUP);
  attachInterrupt(digitalPinToInterrupt(KEYBOARD_CLK), onExti, FALLING);
  ESP_LOGI(TAG, "AT keyboard interface init ok");
}

void KeyboardDriverAT::Reset()
{
  xQueueReset(q);
}

uint8_t KeyboardDriverAT::Poll()
{
  uint8_t scancode;
  if(xQueueReceive(q, &scancode, 0) != pdTRUE)
    return 0;
  const uint8_t setOneScancode = translateScancode(scancode);
  return setOneScancode;
}

void KeyboardDriverAT::onExti()
{
  static uint32_t shifter = 0;
  static uint8_t bitcount = 0;
  static uint32_t prev_ms = 0;
  uint32_t now_ms;
  uint8_t n, val;

  int clock = digitalRead(KEYBOARD_CLK);
  if (clock == 1)
    return;

  val = digitalRead(KEYBOARD_DATA);
  now_ms = millis();
  if (now_ms - prev_ms > 5) {
    bitcount = 0;
    shifter = 0;
  }
  prev_ms = now_ms;

  shifter >>= 1;
  shifter |= (val ? 0x400 : 0);
  bitcount++;
  static const uint32_t WORDLENGTH = 11;
  if (bitcount == WORDLENGTH) {
    bitcount = 0;
    portBASE_TYPE foo;
    const uint8_t scancode = static_cast<uint8_t>((shifter >> 1) & 0xFF);
    if(scancode != 0)
    {
      xQueueSendFromISR(q, &scancode, &foo);
    }
  }
}

uint8_t KeyboardDriverAT::translateScancode(uint8_t code)
{
  static const uint8_t xlatTable[] = {
/*        00    01    02    03    04    05    06    07    08    09    0A    0B    0C    0D    0E    0F */
/*00*/  0x00, 0x43, 0x41, 0x3f, 0x3d, 0x3b, 0x3c, 0x58, 0x64, 0x44, 0x42, 0x40, 0x3e, 0x0f, 0x29, 0x59,
/*10*/  0x65, 0x38, 0x2a, 0x70, 0x1d, 0x10, 0x02, 0x5a, 0x66, 0x71, 0x2c, 0x1f, 0x1e, 0x11, 0x03, 0x5b,
/*20*/  0x67, 0x2e, 0x2d, 0x20, 0x12, 0x05, 0x04, 0x5c, 0x68, 0x39, 0x2f, 0x21, 0x14, 0x13, 0x06, 0x5d,
/*30*/  0x69, 0x31, 0x30, 0x23, 0x22, 0x15, 0x07, 0x5e, 0x6a, 0x72, 0x32, 0x24, 0x16, 0x08, 0x09, 0x5f,
/*40*/  0x6b, 0x33, 0x25, 0x17, 0x18, 0x0b, 0x0a, 0x60, 0x6c, 0x34, 0x35, 0x26, 0x27, 0x19, 0x0c, 0x61,
/*50*/  0x6d, 0x73, 0x28, 0x74, 0x1a, 0x0d, 0x62, 0x6e, 0x3a, 0x36, 0x1c, 0x1b, 0x75, 0x2b, 0x63, 0x76,
/*60*/  0x55, 0x56, 0x77, 0x78, 0x79, 0x7a, 0x0e, 0x7b, 0x7c, 0x4f, 0x7d, 0x4b, 0x47, 0x7e, 0x7f, 0x6f,
/*70*/  0x52, 0x53, 0x50, 0x4c, 0x4d, 0x48, 0x01, 0x45, 0x57, 0x4e, 0x51, 0x4a, 0x37, 0x49, 0x46, 0x54,
/*80*/  0x80, 0x81, 0x82, 0x41, 0x54, 0x85, 0x86, 0x87, 0x88, 0x89, 0x8a, 0x8b, 0x8c, 0x8d, 0x8e, 0x8f,
/*90*/  0x90, 0x91, 0x92, 0x93, 0x94, 0x95, 0x96, 0x97, 0x98, 0x99, 0x9a, 0x9b, 0x9c, 0x9d, 0x9e, 0x9f,
/*A0*/  0xa0, 0xa1, 0xa2, 0xa3, 0xa4, 0xa5, 0xa6, 0xa7, 0xa8, 0xa9, 0xaa, 0xab, 0xac, 0xad, 0xae, 0xaf,
/*B0*/  0xb0, 0xb1, 0xb2, 0xb3, 0xb4, 0xb5, 0xb6, 0xb7, 0xb8, 0xb9, 0xba, 0xbb, 0xbc, 0xbd, 0xbe, 0xbf,
/*C0*/  0xc0, 0xc1, 0xc2, 0xc3, 0xc4, 0xc5, 0xc6, 0xc7, 0xc8, 0xc9, 0xca, 0xcb, 0xcc, 0xcd, 0xce, 0xcf,
/*D0*/  0xd0, 0xd1, 0xd2, 0xd3, 0xd4, 0xd5, 0xd6, 0xd7, 0xd8, 0xd9, 0xda, 0xdb, 0xdc, 0xdd, 0xde, 0xdf,
/*E0*/  0xe0, 0xe1, 0xe2, 0xe3, 0xe4, 0xe5, 0xe6, 0xe7, 0xe8, 0xe9, 0xea, 0xeb, 0xec, 0xed, 0xee, 0xef,
/*F0*/  0x00, 0xf1, 0xf2, 0xf3, 0xf4, 0xf5, 0xf6, 0xf7, 0xf8, 0xf9, 0xfa, 0xfb, 0xfc, 0xfd, 0xfe, 0xff
  };
  static bool prefixE0    = false;
  static bool pause       = false;
  static bool keyRelease  = false;
  uint8_t translation;

  switch(code)
  {
    case 0xE0:
      prefixE0 = true;
      return 0;
    case 0xE1:
      /* from: E1 14 77 E1 F0 14 F0 77*/
      /*   to: E1 1D 45 E1    9D    C5*/
      pause = true;
      return 0;
    case 0xF0:
      keyRelease = true;
      return 0;
    default:
      // if(prefixE0)
      // {
      //   /* ... */
      //   /* right ALT */
      //   /* right Ctrl */
      //   /* right GUI */
      //   /* left GUI */
      //   /* apps (?) */
      //   /* ACPI power */
      //   /* ACPI sleep */
      //   /* ACPI wake */

      //   /* KP /  (4Ah) */
      //   /* End   (69h) */
      //   /* Left  (6Bh) */
      //   /* Home  (6Ch) */
      //   /* Ins   (70h) */
      //   /* Del   (71h) */
      //   /* Down  (72h) */
      //   /* Right (74h) */
      //   /* Up    (75h) */
      //   /* PgDn  (7Ah) */
      //   /* PgUp  (7Dh) */

      //   prefixE0 = false;
      // }
      // else 
      if(pause)
      {
        /* ... */
        pause = false;
      }
      else
      {
        translation = xlatTable[code];
        if(keyRelease)
        {
          static const uint8_t BREAK = 0x80;
          translation |= BREAK;
          keyRelease = false;
        }
        return translation;
      }
  }
}

#endif /* KEYBOARD_DRIVER */
